## systypes/Common/sdkconfig.defaults
```kconfig
# Common sdkconfig.defaults - shared across all SysTypes
# SysType-specific sdkconfig.defaults files override these settings

# Default log level
CONFIG_LOG_DEFAULT_LEVEL_DEBUG=n

# Serial Baud-Rate
CONFIG_ESP_CONSOLE_UART_BAUDRATE=115200

# UART option to avoid dropping chars
CONFIG_UART_ISR_IN_IRAM=y

# Flash size
CONFIG_ESPTOOLPY_FLASHSIZE_4MB=y

# Partition Table
CONFIG_PARTITION_TABLE_CUSTOM=y
CONFIG_PARTITION_TABLE_CUSTOM_FILENAME="build/raft/partitions.csv"

# Common ESP-related
CONFIG_ESP_MAIN_TASK_STACK_SIZE=20000

# FreeRTOS
CONFIG_FREERTOS_HZ=1000
CONFIG_FREERTOS_USE_TRACE_FACILITY=y
CONFIG_FREERTOS_USE_STATS_FORMATTING_FUNCTIONS=y
CONFIG_FREERTOS_VTASKLIST_INCLUDE_COREID=y
CONFIG_FREERTOS_GENERATE_RUN_TIME_STATS=y

# Event Loop Library
CONFIG_ESP_EVENT_POST_FROM_ISR=y
CONFIG_ESP_EVENT_POST_FROM_IRAM_ISR=y

# Bluetooth (disabled by default; systypes that need it override with =y and sub-options)
CONFIG_BT_ENABLED=n

# LWIP
CONFIG_LWIP_SO_RCVBUF=y
CONFIG_LWIP_SO_LINGER=y
CONFIG_LWIP_L2_TO_L3_COPY=y
CONFIG_LWIP_MAX_SOCKETS=24
CONFIG_LWIP_MAX_ACTIVE_TCP=32
CONFIG_LWIP_MAX_LISTENING_TCP=8
CONFIG_LWIP_TCP_MSL=10000

# WiFi options - to reduce iRAM usage
CONFIG_ESP_WIFI_IRAM_OPT=n
CONFIG_ESP_WIFI_RX_IRAM_OPT=n

# Ethernet (disabled by default; systypes that need it override with =y and sub-options)
# Note: ETH_USE_SPI_ETHERNET defaults to y and 'select's ETH_ENABLED, so must be explicitly disabled
CONFIG_ETH_ENABLED=n
CONFIG_ETH_USE_SPI_ETHERNET=n

# mDNS
CONFIG_MDNS_PREDEF_NETIF_STA=y

# Build type
CONFIG_COMPILER_OPTIMIZATION_SIZE=y
CONFIG_COMPILER_OPTIMIZATION_ASSERTIONS_DISABLE=y

# Disable HTTPS certificate bundle to save ~133KB
CONFIG_MBEDTLS_CERTIFICATE_BUNDLE=n
```

## systypes/ScaderDoors/sdkconfig.defaults
```kconfig
# Define configuration
# Remove/repace these comments to set level to debug/info

# Default log level
CONFIG_LOG_DEFAULT_LEVEL_DEBUG=n

# Serial Baud-Rate
CONFIG_ESP_CONSOLE_UART_BAUDRATE=115200

# Flash size
CONFIG_ESPTOOLPY_FLASHSIZE_4MB=y

# Partition Table
CONFIG_PARTITION_TABLE_CUSTOM=y
CONFIG_PARTITION_TABLE_CUSTOM_FILENAME="systypes/ScaderLocks/partitions.csv"

# Common ESP-related
CONFIG_ESP_MAIN_TASK_STACK_SIZE=20000

# FreeRTOS
CONFIG_FREERTOS_HZ=1000
CONFIG_FREERTOS_USE_TRACE_FACILITY=y
CONFIG_FREERTOS_USE_STATS_FORMATTING_FUNCTIONS=y
CONFIG_FREERTOS_VTASKLIST_INCLUDE_COREID=y
CONFIG_FREERTOS_GENERATE_RUN_TIME_STATS=y

# Event Loop Library
# CONFIG_ESP_EVENT_LOOP_PROFILING is not set
CONFIG_ESP_EVENT_POST_FROM_ISR=y
CONFIG_ESP_EVENT_POST_FROM_IRAM_ISR=y

# Uncomment the following for heap-tracing support
#CONFIG_HEAP_TRACING_OFF=y
#CONFIG_HEAP_TRACING_STANDALONE=y
#CONFIG_HEAP_TRACING_STACK_DEPTH=5

# Bluetooth
CONFIG_BT_ENABLED=y
CONFIG_BTDM_CTRL_MODE_BLE_ONLY=y
CONFIG_BTDM_CTRL_MODE_BR_EDR_ONLY=n
CONFIG_BTDM_CTRL_MODE_BTDM=n
CONFIG_BT_NIMBLE_ENABLED=y
CONFIG_BT_NIMBLE_ROLE_CENTRAL=y
CONFIG_BT_NIMBLE_ROLE_OBSERVER=n
CONFIG_BT_NIMBLE_CRYPTO_STACK_MBEDTLS=n
CONFIG_BT_NIMBLE_LOG_LEVEL_WARNING=y
#CONFIG_BT_NIMBLE_MEM_ALLOC_MODE_EXTERNAL=y

# LWIP
CONFIG_LWIP_SO_RCVBUF=y
CONFIG_LWIP_SO_LINGER=y
CONFIG_LWIP_L2_TO_L3_COPY=y
CONFIG_LWIP_MAX_SOCKETS=16

# WiFi options - to reduce memory overhead
#CONFIG_ESP_WIFI_STATIC_RX_BUFFER_NUM=6
#CONFIG_ESP_WIFI_DYNAMIC_RX_BUFFER_NUM=12
#CONFIG_ESP_WIFI_DYNAMIC_TX_BUFFER_NUM=12
#CONFIG_ESP_WIFI_RX_BA_WIN=6

# WiFi options - to reduce iRAM usage
CONFIG_ESP_WIFI_IRAM_OPT=n
CONFIG_ESP_WIFI_RX_IRAM_OPT=n

# Ethernet
CONFIG_ETH_ENABLED=n
CONFIG_ETH_USE_ESP32_EMAC=y
CONFIG_ETH_PHY_INTERFACE_RMII=y
CONFIG_ETH_RMII_CLK_OUTPUT=y
CONFIG_ETH_RMII_CLK_OUT_GPIO=17
CONFIG_ETH_DMA_BUFFER_SIZE=512
CONFIG_ETH_DMA_RX_BUFFER_NUM=10
CONFIG_ETH_DMA_TX_BUFFER_NUM=10
CONFIG_ETH_USE_SPI_ETHERNET=y
CONFIG_ETH_SPI_ETHERNET_W5500=y
```

## systypes/ScaderLeds/sdkconfig.defaults
```kconfig
# ScaderLeds-specific overrides (Common sdkconfig.defaults provides the base)

# Ethernet
CONFIG_ETH_ENABLED=y
CONFIG_ETH_USE_ESP32_EMAC=y
CONFIG_ETH_PHY_INTERFACE_RMII=y
CONFIG_ETH_RMII_CLK_OUTPUT=y
CONFIG_ETH_RMII_CLK_OUT_GPIO=17
CONFIG_ETH_DMA_BUFFER_SIZE=512
CONFIG_ETH_DMA_RX_BUFFER_NUM=10
CONFIG_ETH_DMA_TX_BUFFER_NUM=10
CONFIG_ETH_USE_SPI_ETHERNET=y
CONFIG_ETH_SPI_ETHERNET_W5500=y

# RMT Configuration for reliable LED control with large strips
CONFIG_RMT_TX_ISR_CACHE_SAFE=y
CONFIG_RMT_RECV_FUNC_IN_IRAM=y
```

## systypes/ScaderLedsSandBot/sdkconfig.defaults
```kconfig
# ScaderLedsSandBot-specific overrides (Common sdkconfig.defaults provides the base)

# Serial Console - USB Serial JTAG (ESP32-S3)
CONFIG_ESP_CONSOLE_USB_SERIAL_JTAG=y
CONFIG_ESP_CONSOLE_SECONDARY_USB_SERIAL_JTAG=n

# WiFi options - keep in IRAM for performance
CONFIG_ESP_WIFI_IRAM_OPT=y
CONFIG_ESP_WIFI_RX_IRAM_OPT=y

# WiFi options to help prevent WiFi errors
CONFIG_ESP_WIFI_STA_DISCONNECTED_PM_ENABLE=n

# RMT Configuration for reliable LED control with large strips
CONFIG_RMT_TX_ISR_CACHE_SAFE=y
CONFIG_RMT_RECV_FUNC_IN_IRAM=y

# Power management
CONFIG_PM_ENABLE=n
```

## systypes/ScaderLedsWaveshare/sdkconfig.defaults
```kconfig
# ScaderLedsWaveshare-specific overrides (Common sdkconfig.defaults provides the base)

# Serial Console - USB Serial JTAG (ESP32-S3)
CONFIG_ESP_CONSOLE_USB_SERIAL_JTAG=y
CONFIG_ESP_CONSOLE_SECONDARY_USB_SERIAL_JTAG=n

# TCP buffer sizes
CONFIG_LWIP_TCP_SND_BUF_DEFAULT=16384
CONFIG_LWIP_TCP_WND_DEFAULT=16384

# Ethernet - W5500 via SPI (no EMAC)
CONFIG_ETH_USE_ESP32_EMAC=n
CONFIG_ETH_USE_OPENETH=n

# SPI
CONFIG_SPI_MASTER_ISR_IN_IRAM=y
CONFIG_SPI_SLAVE_ISR_IN_IRAM=y

# RMT Configuration for reliable LED control with large strips
CONFIG_RMT_TX_ISR_CACHE_SAFE=y
CONFIG_RMT_RECV_FUNC_IN_IRAM=y
```

## systypes/ScaderOpener/sdkconfig.defaults
```kconfig
# ScaderOpener-specific overrides (Common sdkconfig.defaults provides the base)

# Serial Console - USB Serial JTAG (ESP32-S3)
CONFIG_ESP_PHY_ENABLE_USB=y
CONFIG_ESP_CONSOLE_USB_CDC=n
CONFIG_ESP_CONSOLE_USB_SERIAL_JTAG=y
CONFIG_ESP_CONSOLE_SECONDARY_USB_SERIAL_JTAG=n
```

## systypes/ScaderPresence/sdkconfig.defaults
```kconfig
# ScaderPresence-specific overrides (Common sdkconfig.defaults provides the base)

# Serial Console - UART (not USB)
CONFIG_ESP_PHY_ENABLE_USB=n
CONFIG_ESP_CONSOLE_UART_DEFAULT=y
CONFIG_ESP_CONSOLE_USB_CDC=n
CONFIG_ESP_CONSOLE_USB_SERIAL_JTAG=n
CONFIG_ESP_CONSOLE_SECONDARY_USB_SERIAL_JTAG=y
```

## systypes/ScaderShades/sdkconfig.defaults
```kconfig
# ScaderShades-specific overrides (Common sdkconfig.defaults provides the base)

# Ethernet
CONFIG_ETH_ENABLED=y
CONFIG_ETH_USE_ESP32_EMAC=y
CONFIG_ETH_PHY_INTERFACE_RMII=y
CONFIG_ETH_RMII_CLK_OUTPUT=y
CONFIG_ETH_RMII_CLK_OUT_GPIO=17
CONFIG_ETH_DMA_BUFFER_SIZE=512
CONFIG_ETH_DMA_RX_BUFFER_NUM=10
CONFIG_ETH_DMA_TX_BUFFER_NUM=10
CONFIG_ETH_USE_SPI_ETHERNET=y
CONFIG_ETH_SPI_ETHERNET_W5500=y
```

## systypes/ShadesScader/sdkconfig.defaults
```kconfig
# Define configuration
# Remove/repace these comments to set level to debug/info

#CONFIG_LOG_DEFAULT_LEVEL_DEBUG=y
#CONFIG_LOG_DEFAULT_LEVEL=4

# Serial Baud-Rate
CONFIG_ESP_CONSOLE_UART_BAUDRATE=115200

# Serial flasher config
CONFIG_ESPTOOLPY_FLASHSIZE_4MB=y
CONFIG_ESPTOOLPY_FLASHSIZE="4MB"

# Partition Table
CONFIG_PARTITION_TABLE_CUSTOM=y
CONFIG_PARTITION_TABLE_CUSTOM_FILENAME="buildConfigs/ShadesScader/partitions.csv"

# Bluetooth
CONFIG_BT_ENABLED=n
CONFIG_BTDM_CTRL_MODE_BLE_ONLY=y
CONFIG_BT_NIMBLE_ENABLED=y
CONFIG_BT_NIMBLE_SVC_GAP_DEVICE_NAME="Scader"
CONFIG_BT_NIMBLE_ROLE_CENTRAL=n
CONFIG_BT_NIMBLE_ROLE_OBSERVER=n
CONFIG_BT_NIMBLE_CRYPTO_STACK_MBEDTLS=n
CONFIG_BT_NIMBLE_LOG_LEVEL_WARNING=y
#CONFIG_BT_NIMBLE_MEM_ALLOC_MODE_EXTERNAL=y

# LWIP
CONFIG_LWIP_LOCAL_HOSTNAME="scader"
CONFIG_LWIP_SO_RCVBUF=y
CONFIG_LWIP_SO_LINGER=y
CONFIG_LWIP_L2_TO_L3_COPY=y
CONFIG_LWIP_MAX_SOCKETS=20

# WiFi options - to reduce memory overhead
#CONFIG_ESP_WIFI_STATIC_RX_BUFFER_NUM=6
#CONFIG_ESP_WIFI_DYNAMIC_RX_BUFFER_NUM=12
#CONFIG_ESP_WIFI_DYNAMIC_TX_BUFFER_NUM=12
#CONFIG_ESP_WIFI_RX_BA_WIN=6

# Event Loop Library
# CONFIG_ESP_EVENT_LOOP_PROFILING is not set
CONFIG_ESP_EVENT_POST_FROM_ISR=y
CONFIG_ESP_EVENT_POST_FROM_IRAM_ISR=y

# Ethernet
CONFIG_ETH_ENABLED=y
CONFIG_ETH_USE_ESP32_EMAC=y
CONFIG_ETH_PHY_INTERFACE_RMII=y
# CONFIG_ETH_RMII_CLK_INPUT is not set
CONFIG_ETH_RMII_CLK_OUTPUT=y
# CONFIG_ETH_RMII_CLK_OUTPUT_GPIO0 is not set
CONFIG_ETH_RMII_CLK_OUT_GPIO=17
CONFIG_ETH_DMA_BUFFER_SIZE=512
CONFIG_ETH_DMA_RX_BUFFER_NUM=10
CONFIG_ETH_DMA_TX_BUFFER_NUM=10
CONFIG_ETH_USE_SPI_ETHERNET=y
# CONFIG_ETH_SPI_ETHERNET_DM9051 is not set
CONFIG_ETH_SPI_ETHERNET_W5500=y
# CONFIG_ETH_SPI_ETHERNET_KSZ8851SNL is not set
# CONFIG_ETH_USE_OPENETH is not set

# Common ESP-related
#CONFIG_ESP_MAIN_TASK_STACK_SIZE=20000
#CONFIG_ESP_IPC_TASK_STACK_SIZE=10000
#CONFIG_ESP_TASK_WDT_PANIC=y

# FreeRTOS
CONFIG_FREERTOS_HZ=1000
CONFIG_FREERTOS_USE_TRACE_FACILITY=y
CONFIG_FREERTOS_USE_STATS_FORMATTING_FUNCTIONS=y
CONFIG_FREERTOS_VTASKLIST_INCLUDE_COREID=y
CONFIG_FREERTOS_GENERATE_RUN_TIME_STATS=y

# For MicroPython
# CONFIG_FREERTOS_SUPPORT_STATIC_ALLOCATION=y
# CONFIG_FREERTOS_THREAD_LOCAL_STORAGE_POINTERS=2

# SPIRAM
CONFIG_ESP32_SPIRAM_SUPPORT=n
CONFIG_SPIRAM_CACHE_WORKAROUND=n
CONFIG_SPIRAM_BOOT_INIT=y
CONFIG_SPIRAM_IGNORE_NOTFOUND=y
CONFIG_SPIRAM_USE_MEMMAP=
CONFIG_SPIRAM_USE_CAPS_ALLOC=y
CONFIG_SPIRAM_USE_MALLOC=
CONFIG_SPIRAM_TYPE_AUTO=y
CONFIG_SPIRAM_TYPE_ESPPSRAM32=
CONFIG_SPIRAM_TYPE_ESPPSRAM64=
CONFIG_SPIRAM_SIZE=-1
CONFIG_SPIRAM_SPEED_40M=y
CONFIG_SPIRAM_MEMTEST=n
CONFIG_SPIRAM_BANKSWITCH_ENABLE=y
CONFIG_SPIRAM_BANKSWITCH_RESERVE=8
CONFIG_SPIRAM_TRY_ALLOCATE_WIFI_LWIP=y
CONFIG_SPIRAM_ALLOW_BSS_SEG_EXTERNAL_MEMORY=n
#CONFIG_SPIRAM_MALLOC_RESERVE_INTERNAL=0
#CONFIG_BT_ALLOCATION_FROM_SPIRAM_FIRST=y
#CONFIG_SPIRAM_ALLOW_NOINIT_SEG_EXTERNAL_MEMORY=y

# Uncomment the following for heap-tracing support
#CONFIG_HEAP_TRACING_OFF=y
#CONFIG_HEAP_TRACING_STANDALONE=y
#CONFIG_HEAP_TRACING_STACK_DEPTH=5

# Compiler options: use -Os to reduce size, but keep full assertions
CONFIG_COMPILER_OPTIMIZATION_SIZE=n
#CONFIG_COMPILER_OPTIMIZATION_SIZE=y 
#CONFIG_COMPILER_OPTIMIZATION_ASSERTIONS_ENABLE=y 

# To reduce iRAM usage
CONFIG_ESP_WIFI_IRAM_OPT=n
CONFIG_ESP_WIFI_RX_IRAM_OPT=n
```

## systypes/TestProS3/sdkconfig.defaults
```kconfig
# TestProS3-specific overrides (Common sdkconfig.defaults provides the base)

# Serial Console - USB Serial JTAG (ESP32-S3)
CONFIG_ESP_PHY_ENABLE_USB=y
CONFIG_ESP_CONSOLE_USB_CDC=n
CONFIG_ESP_CONSOLE_USB_SERIAL_JTAG=y
CONFIG_ESP_CONSOLE_SECONDARY_USB_SERIAL_JTAG=n

# Heap debugging - detect corruption at point of occurrence (enable for debugging)
# CONFIG_HEAP_POISONING_COMPREHENSIVE=y
# CONFIG_HEAP_TASK_TRACKING=y
```
